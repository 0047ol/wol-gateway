## firmware/sdkconfig.defaults
```kconfig
CONFIG_IDF_TARGET="esp32c3"
CONFIG_ESPTOOLPY_FLASHSIZE_4MB=y
CONFIG_PARTITION_TABLE_CUSTOM=y
CONFIG_PARTITION_TABLE_CUSTOM_FILENAME="partitions.csv"
CONFIG_ESP_MAIN_TASK_STACK_SIZE=6144
CONFIG_MBEDTLS_CERTIFICATE_BUNDLE=y
CONFIG_LWIP_SNTP_MAX_SERVERS=2
CONFIG_LWIP_CHECK_THREAD_SAFETY=y
CONFIG_HTTPD_MAX_REQ_HDR_LEN=1024

CONFIG_COMPILER_OPTIMIZATION_SIZE=y
CONFIG_MBEDTLS_DYNAMIC_BUFFER=y
CONFIG_BOOTLOADER_APP_ROLLBACK_ENABLE=y
```
